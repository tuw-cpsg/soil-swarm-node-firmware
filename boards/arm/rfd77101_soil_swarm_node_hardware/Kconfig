## boards/arm/rfd77101_soil_swarm_node_hardware/Kconfig.board
```kconfig
# Kconfig - rfd77101_soil_swarm_node_hardware board configuration

config  RFD77101_SOIL_SWARM_NODE_HARDWARE
	bool "rfd77101_soil_swarm_node_hardware"
	depends on SOC_NRF51822_QFAC
```

## boards/arm/rfd77101_soil_swarm_node_hardware/Kconfig.defconfig
```kconfig
# Kconfig - rfd77101_soil_swarm_node_hardware board configuration

if RFD77101_SOIL_SWARM_NODE_HARDWARE

config BOARD
	default "rfd77101_soil_swarm_node_hardware"

if ADC

config ADC_0
	default y

endif # ADC

config BT_CTLR
	default BT

endif # RFD77101_SOIL_SWARM_NODE_HARDWARE
```

## boards/arm/rfd77101_soil_swarm_node_hardware/rfd77101_soil_swarm_node_hardware_defconfig
```kconfig
# SPDX-License-Identifier: Apache-2.0

CONFIG_SOC_SERIES_NRF51X=y
CONFIG_SOC_NRF51822_QFAC=y
CONFIG_RFD77101_SOIL_SWARM_NODE_HARDWARE=y

# enable uart driver
CONFIG_SERIAL=y

# enable console
CONFIG_CONSOLE=y
CONFIG_UART_CONSOLE=y

# bluetooth
CONFIG_BT=y
CONFIG_BT_CTLR=y
```
